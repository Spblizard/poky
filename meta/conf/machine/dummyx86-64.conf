## meta/conf/machine/dummyx86-64.conf
```bitbake
#@TYPE: Machine
#@NAME: QEMU x86-64 machine
#@DESCRIPTION: Machine configuration for running an x86-64 system on QEMU

PREFERRED_PROVIDER_virtual/xserver ?= ""
PREFERRED_PROVIDER_virtual/libgl ?= ""
PREFERRED_PROVIDER_virtual/libgles1 ?= ""
PREFERRED_PROVIDER_virtual/libgles2 ?= ""
PREFERRED_PROVIDER_virtual/libgles3 ?= ""

DEFAULTTUNE ?= "core2-64"
require conf/machine/include/x86/tune-core2.inc

MACHINE_FEATURES += "x86 pci"

MACHINE_ESSENTIAL_EXTRA_RDEPENDS += "v86d"

IMAGE_FSTYPES = "container"

PREFERRED_PROVIDER_virtual/kernel ??= "linux-dummy"
```
